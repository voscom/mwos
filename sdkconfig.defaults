## sdkconfig.defaults
```kconfig
# Занижение порога детектора Brownout (установка порога в 1)
CONFIG_ESP32_BROWNOUT_DET=y
CONFIG_ESP32_BROWNOUT_DET_LVL=1

# Для ESP32-C3 / C6 / H2 (RISC-V)
CONFIG_ESP32C3_BROWNOUT_DET=y
CONFIG_ESP32C3_BROWNOUT_DET_LVL=1

# Для ESP32-S2 / S3
CONFIG_ESP32S2_BROWNOUT_DET=y
CONFIG_ESP32S2_BROWNOUT_DET_LVL=1
```
